## CMakeLists.txt
```
cmake_minimum_required(VERSION 3.28.0)

find_package(Zephyr REQUIRED HINTS $ENV{ZEPHYR_BASE})
project(my_app)

target_sources(app PRIVATE
    src/main.c
    drivers/auxdisplay_gpio_7seg.c
)

target_include_directories(app PRIVATE
    ${CMAKE_CURRENT_SOURCE_DIR}
)
```

## prj.conf
```kconfig
#Activate MEC172x eSPI V2 driver 
CONFIG_ESPI_XEC_V2=y
CONFIG_ESPI=y

#Map eSPI Peripheral Channel to UART1
CONFIG_ESPI_PERIPHERAL_CHANNEL=y
CONFIG_ESPI_PERIPHERAL_UART=y
CONFIG_ESPI_PERIPHERAL_UART_SOC_MAPPING=1

# Zephyr console routed to UART0
CONFIG_CONSOLE=y
CONFIG_UART_CONSOLE=y
CONFIG_PRINTK=y
CONFIG_LOG=y
CONFIG_LOG_MODE_IMMEDIATE=y
CONFIG_LOG_DEFAULT_LEVEL=4
CONFIG_LOG_BUFFER_SIZE=4096
CONFIG_LOG_PROCESS_THREAD_SLEEP_MS=100

#Disable unrealated eSPI functions
CONFIG_ESPI_PERIPHERAL_HOST_IO_PVT=n
CONFIG_ESPI_PERIPHERAL_DEBUG_PORT_80=n
CONFIG_ESPI_PERIPHERAL_8042_KBC=n
CONFIG_ESPI_OOB_CHANNEL=n
CONFIG_ESPI_FLASH_CHANNEL=n
CONFIG_ESPI_TAF=n
CONFIG_ESPI_TAF_XEC_V2=n
# Disable for mec1723 to check notifications
CONFIG_ESPI_AUTOMATIC_WARNING_ACKNOWLEDGE=n
# Sample code doesn't handle ACPI host communication
CONFIG_ESPI_PERIPHERAL_HOST_IO=n

# Disable Zephyr's original implementation
CONFIG_AUXDISPLAY_GPIO_7SEG=n

CONFIG_GPIO=y
CONFIG_AUXDISPLAY=y
```

## src/main.c
```c
#include <errno.h>
#include <zephyr/device.h>
#include <zephyr/drivers/espi.h>
#include <zephyr/kernel.h>
#include <zephyr/logging/log.h>
#include <zephyr/logging/log_ctrl.h>
#include <drivers/auxdisplay.h>

LOG_MODULE_REGISTER(espi_debugger,LOG_LEVEL_DBG);

const struct device *auxdisplay_h =	DEVICE_DT_GET(DT_NODELABEL(auxdisplay_h));

const struct device *auxdisplay_l =	DEVICE_DT_GET(DT_NODELABEL(auxdisplay_l));

static const struct device *const espi_dev = DEVICE_DT_GET(DT_NODELABEL(espi0));

static struct espi_callback p80_cb;

static void p80(const struct device *dev,struct espi_callback *cb,struct espi_event e)
{
    if ((e.evt_details & 0xffff) == ESPI_PERIPHERAL_DEBUG_PORT80) {
        printk("POST: %02x\n", (uint8_t)e.evt_data);
		
		uint8_t p80_code = (uint8_t)e.evt_data;

		uint8_t high = (e.evt_data >> 4) & 0x0F;
		uint8_t low = e.evt_data & 0x0F;

		auxdisplay_write(auxdisplay_h, &high, 1);
		auxdisplay_write(auxdisplay_l, &low, 1);
    }
}

int main(void)
{
	
	LOG_INF("Hello from Main()\n");

	/* Indicate to eSPI controller (host) simplest configuration: Single line,
	 * 20MHz frequency and only logical channel 0 and 1 are supported
	 */
	struct espi_cfg cfg = {
		.io_caps = ESPI_IO_MODE_SINGLE_LINE,
		.channel_caps = ESPI_CHANNEL_PERIPHERAL | ESPI_CHANNEL_VWIRE,
		.max_freq = 20,
	};

	/*Init eSPI device*/
	if (!device_is_ready(espi_dev)) {
		LOG_ERR("%s: eSPI device not ready.", espi_dev->name);
		return -ENODEV;
	}

	if (!device_is_ready(auxdisplay_h) || !device_is_ready(auxdisplay_l)) {
		LOG_ERR("Failed to 7seg display");
		return 0;
	}

	int rc = auxdisplay_cursor_set_enabled(auxdisplay_h, true);

	if (rc != 0) {
		LOG_ERR("Failed to enable cursor on %s: %d",auxdisplay_h->name, rc);
	}

	rc = auxdisplay_cursor_set_enabled(auxdisplay_l, true);

	if (rc != 0) {
		LOG_ERR("Failed to enable cursor on %s: %d",auxdisplay_l->name, rc);
	}

	int ret = espi_config(espi_dev, &cfg);
	if (ret != 0) {
		LOG_ERR("Failed to configure eSPI target channels:%x err: %d", cfg.channel_caps, ret);
	
		return ret;
	} else {
		LOG_INF("eSPI target configured successfully!");
	}

	espi_init_callback(&p80_cb, p80, ESPI_BUS_PERIPHERAL_NOTIFICATION);
	espi_add_callback(espi_dev, &p80_cb);

	/*
	 * Nothing copies UART bytes in software. When the host enables the eSPI
	 * Peripheral Channel, espi_mchp_xec_host_v2.c programs the UART1 I/O BAR
	 * and Serial IRQ. Host UART accesses then reach the UART1 hardware.
	 */
	for (;;) {
		k_sleep(K_FOREVER);
	}
}
```
